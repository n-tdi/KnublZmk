#include <dt-bindings/zmk/keys.h>

/ {
    keymap {
        compatible = "zmk,keymap";

        default_layer {
            bindings = <
            
                &kp KP_N0 &kp KP_N1 &kp KP_N2 &kp KP_N3 &kp KP_N4 &kp KP_N5

            >;
        };
    };
};